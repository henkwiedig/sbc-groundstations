## package/ascent-vendor-firmware/Config.in
```kconfig
config BR2_PACKAGE_ASCENT_VENDOR_FIRMWARE
	bool "ascent-vendor-firmware"
	help
	  Fetches CADDX's stock "Ascent VRX Pro" OTA image and extracts
	  this board's baseband demo firmware out of it -- straight into
	  BINARIES_DIR (images/bb_demo_cx485_2PA.img) -- for the ar8030
	  package's own AR8030_INSTALL_FIRMWARE to copy out of and install.
	  See extract.py's docstring for the full unpack story (RKFW ->
	  RKAF update.img -> rootfs UBI volume).

	  Best-effort throughout: no network, Google Drive's scrape
	  breaking, or ubireader_extract_files missing from PATH (pip
	  install --user ubi_reader) just leaves BINARIES_DIR without
	  bb_demo_cx485_2PA.img and prints a warning -- it must never fail
	  the build.

	  Not meant to be enabled by hand: ar8030's own
	  BR2_PACKAGE_AR8030_FIRMWARE selects this automatically.
```

## package/ml-kernel-modules/Config.in
```kconfig
config BR2_PACKAGE_ML_KERNEL_MODULES
	bool "ml-kernel-modules"
	depends on BR2_LINUX_KERNEL
	depends on BR2_PACKAGE_ML_KERNEL
	help
	  MissingLynk's out-of-tree Artosyn Proxima-9311 kernel modules
	  (ml-kernel modules/): the SD/SDIO host glue (dw_mci-artosyn,
	  needed for the AR8030 on SDIO), GPIO, ADC, PWM, SoC temperature,
	  the AR8030 SDIO driver (artosyn_sdio) and the MMZ/DMA helpers.

	  The MPP-stack reimplementations (ar_osal, ar_sys, ...) are
	  reference-only upstream and are not installed.

if BR2_PACKAGE_ML_KERNEL_MODULES

config BR2_PACKAGE_ML_KERNEL_MODULES_PRUNE
	bool "keep only the Proxima-9311 in-tree module set"
	default y
	help
	  Remove every in-tree kernel module except the set ml-kernel's
	  own modules/stage.sh ships (media/V4L2/wave5/Artosyn camera,
	  pstore, reed_solomon) and what those and the
	  out-of-tree modules depend on. arm64 defconfig leaves several
	  hundred unrelated drivers as modules (~10 MB).

config BR2_PACKAGE_ML_KERNEL_MODULES_KEEP_EXTRA
	string "extra in-tree module dirs to keep"
	depends on BR2_PACKAGE_ML_KERNEL_MODULES_PRUNE
	help
	  Space-separated directories under lib/modules/<version>/ whose
	  modules survive the prune as well (with their dependencies),
	  e.g. "kernel/drivers/gpu/drm/artosyn kernel/fs/fat" for the
	  goggle's display and the SD card's FAT.

endif

comment "ml-kernel-modules needs a Linux kernel and ml-kernel"
	depends on !BR2_LINUX_KERNEL || !BR2_PACKAGE_ML_KERNEL
```

## package/ml-kernel/Config.in
```kconfig
config BR2_PACKAGE_ML_KERNEL
	bool "ml-kernel (Artosyn Proxima-9311 BSP)"
	depends on BR2_LINUX_KERNEL
	help
	  MissingLynk's open kernel BSP for the Artosyn Proxima-9311
	  (AR9311) SoC: Artosyn driver sources, patches against
	  mainline 6.18.36, config fragments and board device trees.

	  Source only. The ml-kernel linux extension
	  (BR2_LINUX_KERNEL_EXT_ML_KERNEL, linux/linux-ext-ml-kernel.mk)
	  copies it into the kernel tree before Buildroot patches and
	  configures it, and turns the board's fragment list into an
	  in-tree ml_defconfig. Use with BR2_LINUX_KERNEL_USE_DEFCONFIG,
	  BR2_LINUX_KERNEL_DEFCONFIG "ml" and
	  BR2_LINUX_KERNEL_INTREE_DTS_NAME "artosyn/<dts>".

	  https://github.com/Missing-Lynk/ml-kernel

if BR2_PACKAGE_ML_KERNEL

config BR2_PACKAGE_ML_KERNEL_BOARD
	string "ml-kernel board"
	default "betafpv-vr04-goggle"
	help
	  Directory under ml-kernel's devices/ whose device tree and
	  config-fragment list are used.

endif
```

## package/msposd/Config.in
```kconfig
config BR2_PACKAGE_MSPOSD
	bool "msposd"
	select BR2_PACKAGE_CAIRO
	select BR2_PACKAGE_LIBEVENT
	select BR2_PACKAGE_SQLITE
	help
	  OpenIPC implementation of MSP Displayport OSD for INAV/Betaflight/ArduPilot

	  https://github.com/OpenIPC/msposd
```

## package/openipc-bsel/Config.in
```kconfig
config BR2_PACKAGE_OPENIPC_BSEL
	bool "openipc-bsel"
	depends on BR2_arm || BR2_aarch64
	help
	  A/B bank selector for boards whose stock bootloader picks which
	  kernel/rootfs bank to boot next, so an OpenIPC image running on
	  either bank can flip which bank boots next, without the stock
	  bootloader's own userspace tool or its rootfs. Two formats, picked
	  by the partition the board has:

	  - "sel" (CADDX Ascent's "fpvboot" u-boot command): a small "BSEL"
	    magic record, reverse-engineered from the stock ar_bsel binary
	  - "gpt0"/"gpt1" (Artosyn PROXIMA 9311, BetaFPV P1): the GPT,
	    whose attribute bit 47 marks the active member of each env,
	    uboot, kernel, dtb and userapp pair for the stock SPL. It lives
	    in one of the two (primary form in gpt0, backup form in gpt1);
	    a switch writes it into the other and then erases the old one,
	    as the stock U-Boot's upgrade does

	  Installs /usr/bin/openipc-bsel, CLI-compatible with the stock tool:
	    openipc-bsel check_flash      read the bank the bootloader boots
	    openipc-bsel check_cmdline    read the running bank (fpvbsel=N,
	                                  or the userapp ubi.mtd= names)
	    openipc-bsel set 0|1          switch the next boot to bank 0/1

	  Enabled by betafpv_vr04_defconfig. Not device-specific by
	  construction: it locates the partition by name.
```

## package/pixelpilot/Config.in
```kconfig
config BR2_PACKAGE_PIXELPILOT
	bool "pixelpilot"
	select BR2_PACKAGE_ROCKCHIP_MPP if !BR2_PACKAGE_PIXELPILOT_V4L2
	help
	  Application that decodes an RTP Video Stream and displays it on screen, for Rockchip devices.

	  https://github.com/OpenIPC/PixelPilot_rk

config BR2_PACKAGE_PIXELPILOT_V4L2
	bool "V4L2 codec platform"
	depends on BR2_PACKAGE_PIXELPILOT
	help
	  Decode (and re-encode for the DVR) with a stateful V4L2
	  memory-to-memory codec, such as wave5 on the Artosyn AR9311,
	  and show the frames with plain DRM/KMS: no Rockchip MPP, RGA
	  or GPU.
```

## package/ws2812-spi/Config.in
```kconfig
config BR2_PACKAGE_WS2812_SPI
	bool "ws2812-spi"
	help
	  Sets a WS2812/SK6812 LED chain driven from a spidev's MOSI
	  (one SPI byte per LED bit at 6.25 MHz) to one colour, e.g. the
	  BetaFPV VR04 goggles' status LED.
```
