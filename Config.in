## Config.in
```kconfig
source "$BR2_EXTERNAL_OPENIPC_SBC_GS_PATH/package/mali-driver-custom/Config.in"
source "$BR2_EXTERNAL_OPENIPC_SBC_GS_PATH/package/rkdeveloptool/Config.in.host"
source "$BR2_EXTERNAL_OPENIPC_SBC_GS_PATH/package/aic8800/Config.in"
source "$BR2_EXTERNAL_OPENIPC_SBC_GS_PATH/package/rtl88x2cu/Config.in"
source "$BR2_EXTERNAL_OPENIPC_SBC_GS_PATH/package/rtl88x2eu/Config.in"
source "$BR2_EXTERNAL_OPENIPC_SBC_GS_PATH/package/rtl8812au/Config.in"
source "$BR2_EXTERNAL_OPENIPC_SBC_GS_PATH/package/wifibroadcast-ng/Config.in"
source "$BR2_EXTERNAL_OPENIPC_SBC_GS_PATH/package/wfb-server/Config.in"
source "$BR2_EXTERNAL_OPENIPC_SBC_GS_PATH/package/librga/Config.in"
source "$BR2_EXTERNAL_OPENIPC_SBC_GS_PATH/package/rockchip-mpp/Config.in"
source "$BR2_EXTERNAL_OPENIPC_SBC_GS_PATH/package/pixelpilot/Config.in"
source "$BR2_EXTERNAL_OPENIPC_SBC_GS_PATH/package/adaptive-link/Config.in"
source "$BR2_EXTERNAL_OPENIPC_SBC_GS_PATH/package/yaml-cli/Config.in"
source "$BR2_EXTERNAL_OPENIPC_SBC_GS_PATH/package/msposd/Config.in"
source "$BR2_EXTERNAL_OPENIPC_SBC_GS_PATH/package/yq/Config.in"
source "$BR2_EXTERNAL_OPENIPC_SBC_GS_PATH/package/drm_info/Config.in"
source "$BR2_EXTERNAL_OPENIPC_SBC_GS_PATH/package/dvrui/Config.in"
source "$BR2_EXTERNAL_OPENIPC_SBC_GS_PATH/package/ascent-vendor-firmware/Config.in"
source "$BR2_EXTERNAL_OPENIPC_SBC_GS_PATH/package/ar8030/Config.in"
source "$BR2_EXTERNAL_OPENIPC_SBC_GS_PATH/package/ar8030-transport-rx/Config.in"

choice
    prompt "GPIO configuration method"
    help
      Select how to configure the gadget mode / factory reset detection.

config BR2_BOARD_GPIO_CONFIG_CHIP_LINE
    bool "Use GPIO chip and line"
    help
      Specify GPIO using chip name and line number.

config BR2_BOARD_GPIO_CONFIG_PIN_NAME
    bool "Use GPIO pin name"
    help
      Specify GPIO using pin name.

config BR2_BOARD_GPIO_CONFIG_ADC_VOLTAGE
    bool "Use ADC voltage divider"
    help
      Boards without dedicated GPIOs for these buttons (e.g. a
      resistor-ladder button network read off a single SARADC channel)
      instead detect a held button by matching the channel's millivolt
      reading against a target value during boot (initrd phase).

endchoice

config BR2_FACTORY_RESET_GPIO_CHIP
    string "Factory reset GPIO chip"
    default ""
    depends on BR2_BOARD_GPIO_CONFIG_CHIP_LINE
    help
      When detected high during boot (initrd phase) issue a factory reset.

config BR2_FACTORY_RESET_GPIO_LINE
    string "Factory reset GPIO line"
    default ""
    depends on BR2_BOARD_GPIO_CONFIG_CHIP_LINE
    help
      When detected high during boot (initrd phase) issue a factory reset.

config BR2_FACTORY_RESET_GPIO_PIN_NAME
    string "Factory reset GPIO pin name"
    default ""
    depends on BR2_BOARD_GPIO_CONFIG_PIN_NAME
    help
      When detected high during boot (initrd phase) issue a factory reset.

config BR2_GADGET_MODE_GPIO_CHIP
    string "Gadget mode GPIO chip"
    default ""
    depends on BR2_BOARD_GPIO_CONFIG_CHIP_LINE
    help
      Starts gadget mode when detected high during boot (initrd phase).

config BR2_GADGET_MODE_GPIO_LINE
    string "Gadget mode GPIO line"
    default ""
    depends on BR2_BOARD_GPIO_CONFIG_CHIP_LINE
    help
      Starts gadget mode when detected high during boot (initrd phase).

config BR2_GADGET_MODE_GPIO_PIN_NAME
    string "Gadget mode GPIO pin name"
    default ""
    depends on BR2_BOARD_GPIO_CONFIG_PIN_NAME
    help
      Starts gadget mode when detected high during boot (initrd phase).

config BR2_FACTORY_RESET_ADC_DEVICE
    string "Factory reset ADC sysfs device"
    default ""
    depends on BR2_BOARD_GPIO_CONFIG_ADC_VOLTAGE
    help
      iio sysfs raw ADC node, e.g.
      /sys/bus/iio/devices/iio:device0/in_voltage6_raw. When its reading
      matches BR2_FACTORY_RESET_ADC_MV (within a fixed tolerance) during
      boot (initrd phase) issue a factory reset.

config BR2_FACTORY_RESET_ADC_MV
    string "Factory reset ADC target millivolts"
    default ""
    depends on BR2_BOARD_GPIO_CONFIG_ADC_VOLTAGE
    help
      Target millivolt reading (10-bit SARADC against a 1.8V reference)
      identifying the held button that triggers a factory reset.

config BR2_GADGET_MODE_ADC_DEVICE
    string "Gadget mode ADC sysfs device"
    default ""
    depends on BR2_BOARD_GPIO_CONFIG_ADC_VOLTAGE
    help
      iio sysfs raw ADC node. When its reading matches
      BR2_GADGET_MODE_ADC_MV (within a fixed tolerance) during boot
      (initrd phase) gadget mode is started.

config BR2_GADGET_MODE_ADC_MV
    string "Gadget mode ADC target millivolts"
    default ""
    depends on BR2_BOARD_GPIO_CONFIG_ADC_VOLTAGE
    help
      Target millivolt reading identifying the held button that starts
      gadget mode.

config BR2_BOARD_HOST
	string "Host/IP of your vrx in your local network"
	default 192.168.1.199
	help
	  Used during ssh-flash target to flash the image.
```

## configs/betafpv_vr04_defconfig
```kconfig
BR2_aarch64=y
BR2_cortex_a53=y
BR2_CCACHE=y
BR2_TOOLCHAIN_EXTERNAL=y
BR2_PACKAGE_OVERRIDE_FILE="${BR2_EXTERNAL_OPENIPC_SBC_GS_PATH}/board/common/local.mk"
BR2_TARGET_GENERIC_HOSTNAME="openipcgs"
BR2_TARGET_GENERIC_ISSUE="Welcome to OpenIPC GS (BetaFPV VR04)"
BR2_ROOTFS_DEVICE_CREATION_DYNAMIC_EUDEV=y
# BR2_PACKAGE_EUDEV_ENABLE_HWDB is not set
BR2_TARGET_GENERIC_ROOT_PASSWD="12345"
# BR2_TARGET_GENERIC_REMOUNT_ROOTFS_RW is not set
BR2_TARGET_GENERIC_GETTY_PORT="ttyS0"
BR2_TARGET_GENERIC_GETTY_BAUDRATE_KEEP=y
BR2_ENABLE_LOCALE_WHITELIST="C en_US"
BR2_GENERATE_LOCALE="C.UTF-8"
BR2_ROOTFS_OVERLAY="${BR2_EXTERNAL_OPENIPC_SBC_GS_PATH}/board/common/overlay ${BR2_EXTERNAL_OPENIPC_SBC_GS_PATH}/board/common/beeper/overlay ${BR2_EXTERNAL_OPENIPC_SBC_GS_PATH}/board/betafpv/vr04/overlay ${BR2_EXTERNAL_OPENIPC_SBC_GS_PATH}/board/local/overlay"
BR2_ROOTFS_POST_BUILD_SCRIPT="${BR2_EXTERNAL_OPENIPC_SBC_GS_PATH}/board/common/post-build-script.sh ${BR2_EXTERNAL_OPENIPC_SBC_GS_PATH}/board/betafpv/vr04/post-build.sh"
BR2_ROOTFS_POST_IMAGE_SCRIPT="${BR2_EXTERNAL_OPENIPC_SBC_GS_PATH}/board/betafpv/vr04/post-image.sh"
BR2_LINUX_KERNEL=y
BR2_LINUX_KERNEL_CUSTOM_TARBALL=y
BR2_LINUX_KERNEL_CUSTOM_TARBALL_LOCATION="https://cdn.kernel.org/pub/linux/kernel/v6.x/linux-6.18.36.tar.xz"
BR2_LINUX_KERNEL_USE_DEFCONFIG=y
BR2_LINUX_KERNEL_DEFCONFIG="ml"
BR2_LINUX_KERNEL_CONFIG_FRAGMENT_FILES="${BR2_EXTERNAL_OPENIPC_SBC_GS_PATH}/board/betafpv/vr04/linux.fragment"
BR2_LINUX_KERNEL_IMAGE=y
BR2_LINUX_KERNEL_DTS_SUPPORT=y
BR2_LINUX_KERNEL_INTREE_DTS_NAME="artosyn/proxima-9311"
BR2_LINUX_KERNEL_EXT_ML_KERNEL=y
BR2_PACKAGE_BUSYBOX_CONFIG="${BR2_EXTERNAL}/package/busybox/busybox.config"
BR2_PACKAGE_BUSYBOX_CONFIG_FRAGMENT_FILES="${BR2_EXTERNAL_OPENIPC_SBC_GS_PATH}/board/betafpv/vr04/busybox.fragment"
BR2_PACKAGE_BUSYBOX_SHOW_OTHERS=y
BR2_PACKAGE_GSTREAMER1=y
BR2_PACKAGE_GST1_PLUGINS_BASE_PLUGIN_APP=y
# BR2_PACKAGE_GST1_PLUGINS_BASE_PLUGIN_AUDIOCONVERT is not set
# BR2_PACKAGE_GST1_PLUGINS_BASE_PLUGIN_VIDEOCONVERTSCALE is not set
# BR2_PACKAGE_GST1_PLUGINS_BASE_PLUGIN_PLAYBACK is not set
# BR2_PACKAGE_GST1_PLUGINS_BASE_PLUGIN_AUDIORESAMPLE is not set
# BR2_PACKAGE_GST1_PLUGINS_BASE_PLUGIN_VOLUME is not set
BR2_PACKAGE_GST1_PLUGINS_GOOD=y
# BR2_PACKAGE_GST1_PLUGINS_GOOD_PLUGIN_AVI is not set
BR2_PACKAGE_GST1_PLUGINS_GOOD_PLUGIN_RTP=y
BR2_PACKAGE_GST1_PLUGINS_GOOD_PLUGIN_ISOMP4=y
BR2_PACKAGE_GST1_PLUGINS_GOOD_PLUGIN_MULTIFILE=y
BR2_PACKAGE_GST1_PLUGINS_GOOD_PLUGIN_UDP=y
# BR2_PACKAGE_GST1_PLUGINS_GOOD_PLUGIN_WAVPARSE is not set
BR2_PACKAGE_GST1_PLUGINS_BAD=y
BR2_PACKAGE_GST1_PLUGINS_BAD_PLUGIN_VIDEOPARSERS=y
BR2_PACKAGE_DOSFSTOOLS=y
BR2_PACKAGE_DOSFSTOOLS_FSCK_FAT=y
BR2_PACKAGE_DOSFSTOOLS_MKFS_FAT=y
BR2_PACKAGE_EXFATPROGS=y
BR2_PACKAGE_MTD=y
BR2_PACKAGE_MTD_UBIBLOCK=y
BR2_PACKAGE_UBOOT_TOOLS=y
BR2_PACKAGE_UBOOT_TOOLS_FWPRINTENV=y
BR2_PACKAGE_EVTEST=y
BR2_PACKAGE_LIBDRM=y
BR2_PACKAGE_LIBDRM_INSTALL_TESTS=y
BR2_PACKAGE_LIBPNG=y
BR2_PACKAGE_LIBGPIOD=y
BR2_PACKAGE_LIBGPIOD_TOOLS=y
BR2_PACKAGE_AUTOFS=y
BR2_PACKAGE_DROPBEAR=y
BR2_PACKAGE_SOCAT=y
BR2_PACKAGE_LRZSZ=y
BR2_PACKAGE_KMOD_TOOLS=y
BR2_PACKAGE_CJSON=y
BR2_PACKAGE_JSON_FOR_MODERN_CPP=y
BR2_PACKAGE_YAML_CPP=y
BR2_PACKAGE_SPDLOG=y
BR2_PACKAGE_MSGPACK=y
BR2_PACKAGE_AR8030=y
BR2_PACKAGE_AR8030_BUS_SDIO=y
# BR2_PACKAGE_AR8030_FIRMWARE is not set
BR2_PACKAGE_AR8030_TUNTAP=y
BR2_PACKAGE_AR8030_TRANSPORT_RX=y
BR2_PACKAGE_AR8030_TRANSPORT_RX_KMOD=y
BR2_PACKAGE_PIXELPILOT=y
BR2_PACKAGE_PIXELPILOT_V4L2=y
BR2_PACKAGE_ML_KERNEL_BOARD="betafpv-vr04-goggle"
BR2_PACKAGE_ML_KERNEL_MODULES=y
BR2_PACKAGE_ML_KERNEL_MODULES_KEEP_EXTRA="kernel/drivers/gpu/drm/artosyn kernel/fs/fat"
BR2_PACKAGE_OPENIPC_BSEL=y
BR2_PACKAGE_ARTO_IMAGE=y
BR2_PACKAGE_ARTLYNK_VR04_VENDOR_FIRMWARE=y
BR2_PACKAGE_HOST_DTC=y
BR2_PACKAGE_HOST_UBOOT_TOOLS=y
BR2_TARGET_ROOTFS_CPIO=y
BR2_TARGET_ROOTFS_CPIO_GZIP=y
BR2_TARGET_ROOTFS_UBIFS=y
BR2_TARGET_ROOTFS_UBIFS_LEBSIZE=0x1f000
BR2_TARGET_ROOTFS_UBIFS_MINIOSIZE=0x800
BR2_TARGET_ROOTFS_UBIFS_MAXLEBCNT=360
# BR2_TARGET_ROOTFS_TAR is not set
```

## package/ar8030-tools/Config.in
```kconfig
config BR2_PACKAGE_AR8030_TOOLS
	bool "ar8030-tools"
	select BR2_PACKAGE_AR8030
	select BR2_PACKAGE_LIBUSB
	help
	  Userspace daemon and diagnostic/pairing tools for the Artosyn
	  AR8030 baseband/RF link (built from the same yz_host_drv SDK as
	  package/ar8030's kernel module):

	  - ar8030-daemon: owns the USB-attached AR8030 once its firmware
	    is running, exposes an RPC service other tools talk to.
	  - bb_pair: baseband pairing/binding with an AR8030-equipped
	    air unit.
	  - ar8030_usb_test_tool: basic USB-level diagnostics.
```

## package/ar8030-transport-rx/Config.in
```kconfig
config BR2_PACKAGE_AR8030_TRANSPORT_RX
	bool "ar8030-transport-rx"
	depends on BR2_PACKAGE_AR8030
	depends on BR2_TOOLCHAIN_HAS_THREADS
	help
	  Ground-side bridge from the AR8030's non-IP baseband data
	  channel (bb_socket) to PixelPilot_rk -- see
	  https://github.com/henkwiedig/ar8030-transport.

	  Reassembles the chunks ar8030-transport-tx sends from the air
	  unit's waybeam frame-shm ring, RTP/H.265-packetizes each
	  completed frame, and forwards it over UDP to PixelPilot's own
	  RTP listener (its "-p" flag, default 5600). No PixelPilot_rk
	  source changes -- a stock pixelpilot binary is the intended
	  consumer.

	  Requires this project's own ar8030 package patch
	  0008-session_socket-preserve-datagram-flag-on-open.patch (see
	  ar8030-transport's README "Required AR8030 SDK fix" -- without
	  it on *both* ends of the link, chunks above ~690 bytes fail).

	  Also builds, installs, and starts ar8030-lifecycled (see
	  ar8030-transport's README "ar8030-lifecycled: link supervisor +
	  bind button") and its ifup/ifdown and connect/drop beep
	  (playsong.sh, board/caddx/vrxpro's own overlay) hooks -- moved
	  here from S97ar8030 (package/ar8030) now that this package is
	  what actually builds the binary; see S98ar8030-transport-rx's own
	  comment for the reset-backend/role difference from the air side.

	  Installs /usr/bin/ar8030-transport-rx, /usr/bin/ar8030-linkctl,
	  /usr/bin/ar8030-lifecycled, and /etc/init.d/S98ar8030-transport-rx.

	  Also installs /usr/bin/ascent-ota, which updates a Caddx Ascent
	  air unit over the link: it serves an ASW image over HTTP on
	  ar_net0 (or copies it over ssh where python3 is missing) and runs
	  the air's sysupgrade --asw=<url|file> --copy-overlay.

	  And /usr/bin/p1-ota, the same for a BetaFPV P1 air unit: it copies
	  an OpenIPC P1_SKY_*.img into the air's /tmp over ssh and runs the
	  air's sysupgrade on it, which keeps the settings and pairing.
	  A stock image puts BetaFPV's or SinYine's stock firmware back.

	  /usr/bin/air-ota picks the one for an image by its header;
	  PixelPilot's Drone -> Actions -> OTA update runs it.

	  And /usr/bin/ar8030-xdata, which writes to the ground chip's host
	  data channel; the chips carry it to the air chip's UART2 (the
	  Caddx Ascent's gimbal pads). `ar8030-xdata relay` forwards UDP
	  datagrams from 127.0.0.1:5770 there, e.g. gs-headtrack's gimbal
	  frames (the VRX Pro's S99headtrack).

if BR2_PACKAGE_AR8030_TRANSPORT_RX

config BR2_PACKAGE_AR8030_TRANSPORT_RX_KMOD
	bool "SDIO kernel module (artosyn_drv)"
	depends on BR2_LINUX_KERNEL
	depends on BR2_PACKAGE_AR8030_BUS_SDIO
	help
	  Builds ar8030-transport's clean-room kernel module (kmod/:
	  artosyn_drv.ko, the SDIO chardev /dev/artosyn_sdio that ar8030d
	  -i 1 talks to, plus the native ar_net0 net_device) for a board
	  whose AR8030 sits on SDIO. It pushes the baseband firmware and
	  config (fw_name=, cfg_name=) when the chip enumerates in boot-ROM
	  mode and stays loaded. Same module OpenIPC/builder's
	  ar8030-transport-tx builds for the air units.

endif

comment "ar8030-transport-rx needs ar8030 and a toolchain w/ threads"
	depends on !BR2_PACKAGE_AR8030 || !BR2_TOOLCHAIN_HAS_THREADS
```

## package/ar8030/Config.in
```kconfig
config BR2_PACKAGE_AR8030
	bool "ar8030"
	help
	  Artosyn AR8030 baseband/RF-link kernel driver (artosyn_drv.ko)
	  for the Caddx VRX Pro's internal USB-attached RF module.

	  Includes the GPIO power-on sequence, firmware+config for the
	  CX486-RF-2PA RF board, and the init script that brings the link
	  up on boot. See package/ar8030-tools for the userspace daemon
	  and pairing/diagnostic tools that talk to it.
```

## package/artlynk-vr04-vendor-firmware/Config.in
```kconfig
config BR2_PACKAGE_ARTLYNK_VR04_VENDOR_FIRMWARE
	bool "artlynk-vr04-vendor-firmware"
	help
	  Extracts the proprietary blobs the BetaFPV VR04 goggles (P1
	  GND) need from BetaFPV's stock P1 GND OTA image into
	  output/images/artlynk-vr04/ and installs:
	    /lib/firmware/cnm/wave521c_k3_codec_fw.bin   (wave5 codec)
	    /lib/firmware/ar8030/ascent_gnd.img          (AR8030 firmware:
	        the Caddx Ascent L Gnd's, an SDIO ground of the Ascent
	        generation, from Ascent_L_Gnd_*.img in the cache)
	    /lib/firmware/ar8030/vr04_gnd.json           (baseband config:
	        the Ascent ground config with the goggles' own power
	        setup and PA calibration from the stock one)
	  The stock SPL, U-Boot, DDR training firmware, env, kernel and
	  DT stay in output/images/artlynk-vr04/: the board's
	  post-image.sh packs the OpenIPC update image on the stock one
	  and checks its kernel container against them. The stock AR8030
	  ground firmware and configs are kept there for later.

	  Nothing is committed and nothing is downloaded: the stock image
	  comes from ARTLYNK_VR04_VENDOR_IMG, else
	  cache/vendor-images/P1_GND_*.img (the pinned release first,
	  then the newest). See extract.py for host prerequisites.
	  Missing pieces are skipped with a warning, never a build
	  failure.

config BR2_PACKAGE_ARTLYNK_VR04_VENDOR_FIRMWARE_BASE_IMAGE
	string "another unit's stock image as the base"
	depends on BR2_PACKAGE_ARTLYNK_VR04_VENDOR_FIRMWARE
	help
	  A stock image in cache/vendor-images/ (or the path in
	  ARTLYNK_VR04_BASE_IMG) that the OpenIPC update image is packed
	  on instead of BetaFPV's P1 GND one, for a unit of the same
	  design from another maker: its SPL, vendor (DDR training), env
	  and U-Boot go into the update image, and its ground baseband
	  config gives the power setup and PA calibration of
	  vr04_gnd.json. The codec firmware still comes from the P1 GND
	  image. The SinYine F1 VRX: SinYine_F1_VRX_20260914_V1.0.0.bin.
```

## package/arto-image/Config.in
```kconfig
config BR2_PACKAGE_ARTO_IMAGE
	bool "arto-image"
	select BR2_PACKAGE_LZO
	help
	  /usr/sbin/arto: reads Artosyn "ARTO" update images, the stock
	  firmware container of the BetaFPV P1 (Artosyn PROXIMA 9311) and
	  the OpenIPC images built in its layout. Lists the header, the
	  partitions and the segments, checks the SHA-256, and streams one
	  partition's data, LZO-decompressed, for sysupgrade to write.

	  Enabled by betafpv_vr04_defconfig.
```
